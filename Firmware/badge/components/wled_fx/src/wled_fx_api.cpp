// SPDX-License-Identifier: EUPL-1.2
// wled_fx public C API (include/wled_fx.h) on top of the WLED strip/segment runtime.
//
// Timing: WLED effects are written for 42 FPS (FRAMETIME 23 ms) and some advance per call, while the
// badge renders every 40 ms. wled_fx_frame() therefore runs a virtual 42 Hz clock: each badge frame
// performs every 42 Hz step that came due (usually 1 or 2, catch-up capped at 3), with millis()/strip.now
// set to that step's time, and outputs the last result.
// Size: the segment renders at max(n, vlen) LEDs; when larger than n it is box-averaged down to the
// n physical pixels (after gamma, i.e. in light space, like a diffuser would).
#ifdef ESP_PLATFORM
#include "freertos/FreeRTOS.h"
#include "freertos/task.h"
static portMUX_TYPE s_mux = portMUX_INITIALIZER_UNLOCKED;
#define LOCK()   portENTER_CRITICAL(&s_mux)
#define UNLOCK() portEXIT_CRITICAL(&s_mux)
#else
#define LOCK()   // ponytail: host harness is single threaded
#define UNLOCK()
#endif
#include <strings.h>
#include "wled.h"
#include "wled_fx_rt.h"
#include "wled_fx_tables.h"
#include "wled_fx_community.h"   // generated by wledport add/remove: X(id, name, sym) rows, may be empty
#include "wled_fx.h"

#define WLED_FX_FPS      42
#define WLED_FX_CATCHUP  3

static wled_params_t s_pending, s_cur;   // s_pending guarded by s_mux; s_cur render task only
static volatile bool s_dirty;
static bool     s_inited, s_clock_run;
static uint32_t s_vnext;                 // next virtual step time (ms) ...
static uint32_t s_vfrac;                 // ... plus fraction in 1/42 ms

// Effect registry = stock table (import) followed by community effects (add), ids ascending.
#define COMM_ROW(id, name, sym) {id, name},
#define COMM_DECL(id, name, sym) extern const wled_fx_comm_t sym;
static const wled_fx_entry_t WLED_FX_COMM_TABLE[] = {WLED_FX_COMMUNITY(COMM_ROW) {0, nullptr}};
WLED_FX_COMMUNITY(COMM_DECL)
static constexpr uint16_t N_STOCK = sizeof(WLED_FX_TABLE) / sizeof(WLED_FX_TABLE[0]);
static constexpr uint16_t N_COMM = sizeof(WLED_FX_COMM_TABLE) / sizeof(WLED_FX_COMM_TABLE[0]) - 1;
static const wled_fx_entry_t &entry(uint16_t i) { return i < N_STOCK ? WLED_FX_TABLE[i] : WLED_FX_COMM_TABLE[i - N_STOCK]; }

static bool available(uint8_t fx) {
  for (uint16_t i = 0; i < N_STOCK + N_COMM; i++)
    if (entry(i).id == fx) return true;
  return false;
}

extern "C" void wled_fx_defaults(uint8_t fx, wled_params_t *out) {
  // Same keys and fallbacks as upstream Segment::setMode(fx, true); colors/vlen are left alone.
  int v;
  v = extractModeDefaults(fx, "sx"); out->sx = v >= 0 ? v : DEFAULT_SPEED;
  v = extractModeDefaults(fx, "ix"); out->ix = v >= 0 ? v : DEFAULT_INTENSITY;
  v = extractModeDefaults(fx, "c1"); out->c1 = v >= 0 ? v : DEFAULT_C1;
  v = extractModeDefaults(fx, "c2"); out->c2 = v >= 0 ? v : DEFAULT_C2;
  v = extractModeDefaults(fx, "c3"); out->c3 = v >= 0 ? v : DEFAULT_C3;
  v = extractModeDefaults(fx, "o1"); out->o1 = v > 0;
  v = extractModeDefaults(fx, "o2"); out->o2 = v > 0;
  v = extractModeDefaults(fx, "o3"); out->o3 = v > 0;
  v = extractModeDefaults(fx, "pal"); out->pal = v >= 0 ? v : 0;  // 0 = the effect's default palette
  out->fx = fx;
}

extern "C" void wled_fx_init(void) {
  if (s_inited) return;
  s_inited = true;
  // ponytail: community ids start at MODE_COUNT and are contiguous, so addEffect() appends each at its id
#define COMM_REG(id, name, sym) strip.addEffect(id, sym.fn, sym.data);
  WLED_FX_COMMUNITY(COMM_REG)
  strip.setTargetFps(WLED_FX_FPS);
  wled_fx_rt_len = 20;  // badge LED count; wled_fx_frame() resizes to max(n, vlen) anyway
  strip.finalizeInit();
  // Default look until someone applies one: WLED's power-on default (Solid, orange).
  wled_params_t p = {};
  wled_fx_defaults(0, &p);
  p.col[0][0] = R(DEFAULT_COLOR); p.col[0][1] = G(DEFAULT_COLOR); p.col[0][2] = B(DEFAULT_COLOR);
  LOCK();
  if (!s_dirty) { s_pending = p; s_dirty = true; }
  UNLOCK();
}

extern "C" void wled_fx_apply(const wled_params_t *p) {
  LOCK();
  s_pending = *p;
  s_dirty = true;
  UNLOCK();
}

static void push_params(const wled_params_t &p, uint16_t len) {
  if (len != wled_fx_rt_len) {     // geometry change: rebuild the segment (mode restarts)
    wled_fx_rt_len = len;
    strip.finalizeInit();
  }
  Segment &s = strip.getMainSegment();
  s.setMode(available(p.fx) ? p.fx : 0, false);
  s.setPalette(p.pal < FIXED_PALETTE_COUNT ? p.pal : 0);
  s.speed = p.sx; s.intensity = p.ix;
  s.custom1 = p.c1; s.custom2 = p.c2; s.custom3 = p.c3 & 0x1F;
  s.check1 = p.o1; s.check2 = p.o2; s.check3 = p.o3;
  for (int i = 0; i < 3; i++) s.colors[i] = RGBW32(p.col[i][0], p.col[i][1], p.col[i][2], 0);
}

extern "C" void wled_fx_frame(uint32_t now_ms, uint8_t out[][3], uint16_t n) {
  if (!s_inited) wled_fx_init();
  if (!n) return;
  bool fresh = false;
  if (s_dirty) {
    LOCK();
    s_cur = s_pending;
    s_dirty = false;
    UNLOCK();
    fresh = true;
  }
  const uint16_t len = s_cur.vlen > n ? (s_cur.vlen > WLED_FX_VLEN_MAX ? WLED_FX_VLEN_MAX : s_cur.vlen) : n;
  if (fresh || len != wled_fx_rt_len) push_params(s_cur, len);  // setMode only restarts on an fx change

  // virtual 42 Hz clock
  if (!s_clock_run || (int32_t)(now_ms - s_vnext) > 1000 || (int32_t)(s_vnext - now_ms) > 1000) {
    s_vnext = now_ms; s_vfrac = 0; s_clock_run = true;   // first frame, or the caller's clock jumped
  }
  for (int k = 0; k < WLED_FX_CATCHUP && (int32_t)(now_ms - s_vnext) >= 0; k++) {
    wled_fx_clock_ms = s_vnext;
    strip.service();
    s_vfrac += 1000;
    s_vnext += s_vfrac / WLED_FX_FPS;
    s_vfrac %= WLED_FX_FPS;
  }
  if ((int32_t)(now_ms - s_vnext) >= 0) { s_vnext = now_ms + 1; s_vfrac = 0; }  // too far behind: drop

  // strip buffer -> n physical pixels: gamma per LED, then box average
  for (uint16_t i = 0; i < n; i++) {
    uint32_t a = (uint32_t)i * len / n, b = (uint32_t)(i + 1) * len / n, r = 0, g = 0, bl = 0;
    for (uint32_t j = a; j < b; j++) {
      uint32_t c = strip.getPixelColorNoMap(j);
      if (gammaCorrectCol) c = gamma32(c);
      r += R(c); g += G(c); bl += B(c);
    }
    const uint32_t cnt = b - a;
    out[i][0] = r / cnt; out[i][1] = g / cnt; out[i][2] = bl / cnt;
  }
}

extern "C" uint16_t wled_fx_count(void) { return N_STOCK + N_COMM; }

extern "C" uint8_t wled_fx_id_at(uint16_t i) { return i < wled_fx_count() ? entry(i).id : 0; }

extern "C" const char *wled_fx_name(uint8_t fx) {
  for (uint16_t i = 0; i < wled_fx_count(); i++)
    if (entry(i).id == fx) return entry(i).name;
  return nullptr;
}

extern "C" const char *wled_fx_meta(uint8_t fx) { return available(fx) ? strip.getModeData(fx) : nullptr; }

extern "C" int wled_fx_find(const char *name) {
  for (uint16_t i = 0; name && i < wled_fx_count(); i++)
    if (!strcasecmp(entry(i).name, name)) return entry(i).id;
  return -1;
}

extern "C" uint8_t wled_pal_count(void) { return sizeof(WLED_PAL_NAMES) / sizeof(WLED_PAL_NAMES[0]); }

extern "C" const char *wled_pal_name(uint8_t pal) { return pal < wled_pal_count() ? WLED_PAL_NAMES[pal] : nullptr; }

extern "C" int wled_pal_find(const char *name) {
  for (int i = 0; name && i < wled_pal_count(); i++)
    if (!strcasecmp(WLED_PAL_NAMES[i], name)) return i;
  return -1;
}
