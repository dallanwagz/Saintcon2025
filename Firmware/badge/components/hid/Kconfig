## Firmware/badge/components/hid/Kconfig
```kconfig
menu "HID remote"

    config BADGE_SHORTCUTS
        string "Shortcuts (semicolon separated, 19 characters each, 32 max; empty = no Shortcuts app)"
        default ""
        help
            One-press Home Assistant macros shown first on the main menu. Shortcut n sends a BTHome dimmer
            event rotate_right with steps = 200 + n; one HA automation per badge maps each number to a script
            (ha/wrench_shortcuts.yaml). Append new shortcuts at the end so numbers keep their meaning.

    config BADGE_MENU
        string "Home Assistant menu rows (semicolon separated, 19 characters each, 32 rows max)"
        default "Lights on;Lights off;Strip|Off|Rainbow|Fire;Blinds up;Blinds down;Good night"
        help
            Rows of the HA Menu app. Picking row r broadcasts a BTHome dimmer event rotate_right with steps = r
            (and the row text as sensor.<badge>_text, for the logbook). A row written as "Label|A|B|C" opens a
            popup of entries instead; entry k of row r sends rotate_left with steps = r*10+k (rows 1-24, up to
            9 entries). Automations key on those numbers (ha/wrench_menu_command.yaml), so append new rows and
            entries at the end. Texts are cut to 19 characters.

endmenu
```

## Firmware/badge/components/joystick/Kconfig
```kconfig
menu "Joystick"

    config INPUT_JOY_UP_GPIO
        int "Up GPIO"
        range 0 SOC_GPIO_PIN_COUNT
        default 41
    config INPUT_JOY_DOWN_GPIO
        int "Down GPIO"
        range 0 SOC_GPIO_PIN_COUNT
        default 43
    config INPUT_JOY_LEFT_GPIO
        int "Left GPIO"
        range 0 SOC_GPIO_PIN_COUNT
        default 2
    config INPUT_JOY_RIGHT_GPIO
        int "Right GPIO"
        range 0 SOC_GPIO_PIN_COUNT
        default 42
    config INPUT_JOY_CENTER_GPIO
        int "Center GPIO"
        range 0 SOC_GPIO_PIN_COUNT
        default 44

endmenu
```

## Firmware/badge/components/wled_mirror/Kconfig
```kconfig
menu "Wrench LEDs (WLED mirror)"

    config WLED_PRESETS_FILE
        string "Local WLED preset table (JSON)"
        default "wled_presets.json"
        help
          Path, relative to the project directory, of the git-ignored JSON file that maps HA Menu
          labels to WLED looks (see wled_presets.example.json). A missing file builds an empty table.

    config WLED_MIRROR_STATS
        bool "Log wallpaper frame time and LED task stack every 10 s"
        default n
        help
          Development aid: logs the slowest wled_fx frame and the LED render task's stack
          high-water mark once every ~10 s.

endmenu
```

## Firmware/badge/main/Kconfig.projbuild
```kconfig
menu "Badge Configuration"

    # Shared component configuration menus
    rsource "../shared_components/i2c_manager/Kconfig"
    rsource "../shared_components/led/Kconfig"
    rsource "../shared_components/wifi_manager/Kconfig"

    # Badge-specific component configuration menus
    rsource "../components/battery/Kconfig"
    rsource "../components/display/Kconfig"
    rsource "../components/hid/Kconfig"
    rsource "../components/joystick/Kconfig"
    rsource "../components/minibadge/Kconfig"
    rsource "../components/nfc/Kconfig"

endmenu
```

## Firmware/badge/shared_components/wifi_manager/Kconfig
```kconfig
menu "WiFi"

    config WIFI_MANAGER_ENABLED
        bool "Enable the WiFi manager (connect to saved networks at boot)"
        default n
        help
          When disabled the WiFi stack is never started and the API becomes a set of stubs.

    config WIFI_MAX_NETWORKS
        int "Maximum number of saved WiFi networks (1-10)"
        range 1 10
        default 3
        depends on WIFI_MANAGER_ENABLED

endmenu
```
